/*

  GraphicsTest.pde
  
  >>> Before compiling: Please remove comment from the constructor of the 
  >>> connected graphics display (see below).
  
  Universal 8bit Graphics Library, https://github.com/olikraus/u8glib/
  
  Copyright (c) 2012, olikraus@gmail.com
  All rights reserved.

  Redistribution and use in source and binary forms, with or without modification, 
  are permitted provided that the following conditions are met:

  * Redistributions of source code must retain the above copyright notice, this list 
    of conditions and the following disclaimer.
    
  * Redistributions in binary form must reproduce the above copyright notice, this 
    list of conditions and the following disclaimer in the documentation and/or other 
    materials provided with the distribution.

  THIS SOFTWARE IS PROVIDED BY THE COPYRIGHT HOLDERS AND 
  CONTRIBUTORS "AS IS" AND ANY EXPRESS OR IMPLIED WARRANTIES, 
  INCLUDING, BUT NOT LIMITED TO, THE IMPLIED WARRANTIES OF 
  MERCHANTABILITY AND FITNESS FOR A PARTICULAR PURPOSE ARE 
  DISCLAIMED. IN NO EVENT SHALL THE COPYRIGHT HOLDER OR 
  CONTRIBUTORS BE LIABLE FOR ANY DIRECT, INDIRECT, INCIDENTAL, 
  SPECIAL, EXEMPLARY, OR CONSEQUENTIAL DAMAGES (INCLUDING, BUT 
  NOT LIMITED TO, PROCUREMENT OF SUBSTITUTE GOODS OR SERVICES; 
  LOSS OF USE, DATA, OR PROFITS; OR BUSINESS INTERRUPTION) HOWEVER 
  CAUSED AND ON ANY THEORY OF LIABILITY, WHETHER IN CONTRACT, 
  STRICT LIABILITY, OR TORT (INCLUDING NEGLIGENCE OR OTHERWISE) 
  ARISING IN ANY WAY OUT OF THE USE OF THIS SOFTWARE, EVEN IF 
  ADVISED OF THE POSSIBILITY OF SUCH DAMAGE.  


*/


#include "U8glib.h"
#include <Adafruit_NeoPixel.h>
#include <OneWire.h>
#include <DallasTemperature.h>

#define ONE_WIRE_BUS_1 2
#define ONE_WIRE_BUS_2 3
#define ONE_WIRE_BUS_3 4
#define ONE_WIRE_BUS_4 5

OneWire oneWire_in(ONE_WIRE_BUS_1);
OneWire oneWire_out(ONE_WIRE_BUS_2);
OneWire oneWire_engin(ONE_WIRE_BUS_3);
OneWire oneWire_radiat(ONE_WIRE_BUS_4);


DallasTemperature sensor_inhouse(&oneWire_in);
DallasTemperature sensor_outhouse(&oneWire_out);
DallasTemperature sensor_engin(&oneWire_engin);
DallasTemperature sensor_radiat(&oneWire_radiat);

int fan_startLO = 78;
int fan_startHI = 82;
int fan_off = 72;
int fan_offHI = 77;
int fan = 0;

#define FAN_LO_PIN A0
#define FAN_HI_PIN A2



#define LEDPIN        6 // On Trinket or Gemma, suggest changing this to 1

// How many NeoPixels are attached to the Arduino?
#define NUMPIXELS 2 // Popular NeoPixel ring size
//Adafruit_NeoPixel pixels(NUMPIXELS, LEDPIN, NEO_GRB + NEO_KHZ800);
  Adafruit_NeoPixel pixels(2, 7, NEO_GRB + NEO_KHZ800);
U8GLIB_SSD1309_128X64 u8g( 12, 11, 10, 9, 8 );

static const unsigned char test_bits[] PROGMEM = {
    0x00, 0x00, 0x00, 0x00, 0x00, 0x00, 0x00, 0x00, 0x00, 0x00, 0x00, 0x00,
   0x00, 0x00, 0x00, 0x00, 0x00, 0x00, 0x00, 0x00, 0x00, 0x00, 0x00, 0x00,
   0x00, 0x00, 0x00, 0x00, 0xf8, 0xff, 0xff, 0xff, 0xff, 0xff, 0xff, 0xff,
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   0x00, 0x00, 0x00, 0x00  };


   static const unsigned char oil_bits[] PROGMEM = {
   0x00, 0x00, 0x00, 0x00, 0x00, 0x00, 0x00, 0x00, 0x00, 0x00, 0x00, 0x00,
   0x00, 0x00, 0x00, 0x00, 0x00, 0x00, 0x00, 0x00, 0x00, 0x00, 0x00, 0x00,
   0x00, 0x00, 0x00, 0x00, 0x00, 0x00, 0x00, 0x00, 0x00, 0x00, 0x00, 0x00,
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   0x00, 0x00, 0x00, 0x00   };


 int analogInput = A3;                 // شماره پایه ورودی ولتاژ را وارد کنید
uint8_t draw_state = 0;
uint8_t page = 0;


float  temperatures_IN = 0;
float  temperatures_OUT = 0;

float  temperatures_ENG = 0;
float  temperatures_RAD = 0;

char volt[8]; // Buffer big enough for 7-character float

char temperatures_IN_C[6] = "-";
boolean temperatures_IN_Manfi = 0;


char temperatures_OUT_C[6] = "-";
boolean temperatures_OUT_Manfi = 0;

char temperatures_ENG_C[6] = "-";
boolean temperatures_ENG_Manfi = 0;
int temperatures_ENG_dis = 0;



char temperatures_RAD_C[6] = "-";
boolean temperatures_RAD_Manfi = 0;


void u8g_prepare(void) {
  u8g.setFont(u8g_font_6x10);
  u8g.setFontRefHeightExtendedText();
  u8g.setDefaultForegroundColor();
  u8g.setFontPosTop();
}

void draw(void) {
  u8g_prepare();


      if (page == 0) {


   
//    ;
    
          u8g.drawStr(13 , 16, "TOYOTA");
u8g.drawStr(93 , 16, "1979");

  u8g.drawXBMP( 11, 24, 105, 19, test_bits);
  
//  Serial.println(draw_state);
//  u8g.drawBox(14,45,draw_state,3);
  u8g.drawBox(64 - (draw_state) ,45 , draw_state*2,3);
      }

       if (page == 1) {
//          u8g.drawStr(13 , 16, "Hello");
 uint8_t i, h , hll;
  u8g_uint_t w, d;


//u8g.drawFrame(0,0,128,64);
//u8g.drawFrame(63,0,2 ,64);
  u8g.setFont(u8g_font_6x13);
  u8g.setFontRefHeightText();
  u8g.setFontPosTop();
  
  h = u8g.getFontAscent()-u8g.getFontDescent();
  w = u8g.getWidth();
  
   d = (w-u8g.getStrWidth("OIL"))/2;
    
  u8g.drawStr(d , 4, "OIL");


    u8g.setFont(u8g_font_6x10);
     u8g.drawStr(19 , 17, "L");
u8g.drawStr(104 , 17, "H");

u8g.drawBox(19 ,20 , 90,3);
u8g.drawBox(19 ,23 , 3,5);
u8g.drawBox(106 ,23 , 3,5);
u8g.drawBox(63 ,23 , 2,3);


// u8g.drawXBMP( 0, 5, 128, 64, oil_bits);
//  u8g.setFont(u8g_font_u8glib_4);
//u8g.setFont(u8g_font_micro);
//u8g.setFont(u8g_font_5x8);

   
int a = -2;
int b = 10;


 u8g.setFont(u8g_font_04b_03br);
   u8g.drawStr(20+ a , 40 + b, volt);
 u8g.drawStr(24+ a , 48 + b, "VOLT");

u8g.drawBox(45+ a ,35 + b , 1,13);





if (temperatures_OUT == 127 && temperatures_OUT_Manfi) {
   u8g.drawStr(58+ a , 40 + b, "---");
} else {
if (temperatures_OUT_Manfi)  u8g.drawStr(58 + a, 36 + b, "-" );           
  u8g.drawStr(58+ a , 40 + b, temperatures_OUT_C);

}





if (temperatures_IN == 127 && temperatures_IN_Manfi) {
    u8g.drawStr(58 + a , 48 + b, "---");
} else {
if (temperatures_IN_Manfi)  u8g.drawStr(58+ a , 44 + b, "-" );           
  u8g.drawStr(58 + a , 48 + b, temperatures_IN_C);

}





   u8g.setFont(u8g_font_blipfest_07 );
     u8g.drawStr(49 + a, 40 + b , "OU" );
   u8g.drawStr(49 + a, 48 + b, "IN" );   



u8g.drawBox(77+ a ,35  + b, 1,13);

   u8g.setFont(u8g_font_blipfest_07 );
     u8g.drawStr(81+ a , 40  + b, "ENG" );
   u8g.drawStr(81+ a , 48 + b, "RAD" );   





 u8g.setFont(u8g_font_04b_03br);



if (temperatures_ENG == 127 && temperatures_ENG_Manfi) {
    u8g.drawStr( 94+ a , 40 + b, "---");
} else {
  if (temperatures_ENG_Manfi)  u8g.drawStr(94+ a , 36 + b, "-" );           
  u8g.drawStr( 94+ a , 40 + b, temperatures_ENG_C);
}



if (temperatures_RAD == 127 && temperatures_RAD_Manfi) {
    u8g.drawStr(94 + a, 48 + b,  "---");
} else {
if (temperatures_RAD_Manfi)  u8g.drawStr(94+ a , 44 + b, "-" );           
  u8g.drawStr(94 + a, 48 + b, temperatures_RAD_C);

}





   

//if (temperatures_OUT_Manfi)  u8g.drawStr(58 , 36, "-" );           
//  u8g.drawStr(58 , 40, temperatures_OUT_C);
//
//
////
//if (temperatures_IN_Manfi)  u8g.drawStr(58 , 44, "-" );           
//  u8g.drawStr(58 , 48, temperatures_IN_C);
//
//
//
//   u8g.setFont(u8g_font_blipfest_07 );
//     u8g.drawStr(49 , 40 , "OU" );
//   u8g.drawStr(49 , 48, "IN" );   







      }

}

void setup(void) {

  // flip screen, if required
  u8g.setRot180();
Serial.begin(9600);

 pixels.begin(); 
   sensor_inhouse.begin();
    sensor_outhouse.begin();

  pinMode(FAN_LO_PIN, OUTPUT);
  pinMode(FAN_HI_PIN, OUTPUT);
  
 digitalWrite(FAN_LO_PIN, HIGH);
 digitalWrite(FAN_HI_PIN, HIGH);
 
    
  pinMode(analogInput, INPUT);  
#if defined(ARDUINO)
  pinMode(13, OUTPUT);           
  digitalWrite(13, HIGH);  
#endif

    pixels.clear();

     pixels.setPixelColor(1, pixels.Color(200, 0, 0));
pixels.show();


}






    
void loop(void) {
  
  // picture loop  
;
     
  u8g.firstPage();  
  do {
    draw();
  } while( u8g.nextPage() );
  
  // increase the state

           


if (page == 1) {
  voltmeter();
temperatures();
} else {
   draw_state++;
}
  if ( draw_state >= 52 ) {
     draw_state = 0;
     page = 1;
  } else {
    
  }

  // rebuild the picture after some delay
  //delay(150);

  
}

int vi = 1;  
float v1 = 0.0;   
float v2 = 0.0;  
float v3 = 0.0;  
float v4 = 0.0;  
float v5 = 0.0;  
float v6 = 0.0;  
float v7 = 0.0;  

void voltmeter() {




//u8g.drawBox(0 ,32 , 128,1);

float vout = 0.0;                               // متغییر ولتاژ پایه آنلالوگ
float vin = 0.0;                           // ولتاژی که باید نمایش داده شود
float R1 = 100000.0;                        // مقدار مقاومت R1 را وارد کنید
float R2 = 10000.0;                         // مقدار مقاومت R2 را وارد کنید
int value = 0;  // متغییر مقدار آنالوگ قبل از محاسبات                      
   value = analogRead(analogInput);           //خواندن مقدار آنالوگ        
   vout = (value * 4.2) / 1024.0; // تبدیل مقدار خوانده شده به ولتاژ       
   vin = vout / (R2/(R1+R2));  // محاسبه ولتاژ بعد از تقسیم ولتاژ          
// Serial.println(vin);

// Serial.println(vi);
if (vi == 1){
   v1 = vin;
  
}


if (vi > 10) {
  vi = 1;               
} else {
  vi++;
}

vin = v1;
dtostrf(vin, 6, 2, volt); // Leave room for too large numbers!



}



void temperatures() {

      Serial.print("Requesting temperatures...");
    sensor_inhouse.requestTemperatures();
    sensor_outhouse.requestTemperatures();
    sensor_engin.requestTemperatures();
    sensor_radiat.requestTemperatures();


    Serial.println(" done");

    Serial.print("Inhouse: ");
//    Serial.println(sensor_inhouse.getTempCByIndex(0));
temperatures_IN = sensor_inhouse.getTempCByIndex(0);

if (temperatures_IN < 0) {
  temperatures_IN = abs(temperatures_IN);
  temperatures_IN_Manfi = 1;
}else {
  temperatures_IN_Manfi = 0;
}
if (temperatures_IN < 100) {
     dtostrf(temperatures_IN, 2, 1, temperatures_IN_C);
} else {
   dtostrf(temperatures_IN, 2, 0, temperatures_IN_C);
}
 Serial.println(temperatures_IN);

 

    Serial.print("Outhouse: ");
   

temperatures_OUT = sensor_outhouse.getTempCByIndex(0);

if (temperatures_OUT < 0) {
  temperatures_OUT = abs(temperatures_OUT);
  temperatures_OUT_Manfi = 1;
}else {
  temperatures_OUT_Manfi = 0;
}
if (temperatures_OUT < 100) {
     dtostrf(temperatures_OUT, 2, 1, temperatures_OUT_C);
} else {
   dtostrf(temperatures_OUT, 2, 0, temperatures_OUT_C);
}
 Serial.println(temperatures_OUT);





    Serial.print("engin: ");
   
int t_ENG = sensor_engin.getTempCByIndex(0);
 Serial.println(t_ENG);



if (t_ENG == -127) {
  if (temperatures_ENG_dis < 12){
      temperatures_ENG_dis++;
  }
} else {
  temperatures_ENG_dis = 0;
}


  Serial.print("temperatures_ENG_dis: ");
   Serial.println(temperatures_ENG_dis);




if ( temperatures_ENG_dis == 0 || temperatures_ENG_dis > 10) {

temperatures_ENG = t_ENG;




int fan_startLO = 78;
int fan_startHI = 82;
int fan_off = 74;
int fan_offHI = 77 ;



if (temperatures_ENG < fan_off ) {

  fan = 0;
}
if (temperatures_ENG > fan_startLO && fan == 0 ) {

     fan = 1;
}
if (temperatures_ENG < fan_offHI  && fan == 2 ) {

     fan = 1;
}
if (temperatures_ENG > fan_startHI  ) {
 fan = 2;
}

//int fan_startLO = 85;
//int fan_startHI = 89;
//int fan_off = 80;
//int fan_offHI = 83;
//int fan = 0;

if (fan == 0) {
   digitalWrite(FAN_LO_PIN, HIGH);
 digitalWrite(FAN_HI_PIN, HIGH);
}
if (fan == 1) {
   digitalWrite(FAN_LO_PIN, LOW);
 digitalWrite(FAN_HI_PIN, HIGH);
}
if (fan == 2) {
   digitalWrite(FAN_LO_PIN, LOW);
 digitalWrite(FAN_HI_PIN, LOW);
}






//int startLO = 85;
//int startHI = 89;
//int off = 80;





//int fan_startLO = 85;
//int fan_startHI = 89;
//int fan_off = 80;


  


if (temperatures_ENG < 0) {
  temperatures_ENG = abs(temperatures_ENG);
  temperatures_ENG_Manfi = 1;
}else {
  temperatures_ENG_Manfi = 0;
}

  if (temperatures_ENG < 100) {
       dtostrf(temperatures_ENG, 2, 1, temperatures_ENG_C);
  } else {
     dtostrf(temperatures_ENG, 2, 0, temperatures_ENG_C);
  }
}

    Serial.print("fan: ");
   
 Serial.println(fan);

 
    Serial.print("radiat: ");
   

temperatures_RAD = sensor_radiat.getTempCByIndex(0);

if (temperatures_RAD < 0) {
  temperatures_RAD = abs(temperatures_RAD);
  temperatures_RAD_Manfi = 1;
}else {
  temperatures_RAD_Manfi = 0;
}
if (temperatures_RAD < 100) {
     dtostrf(temperatures_RAD, 2, 1, temperatures_RAD_C);
} else {
   dtostrf(temperatures_RAD, 2, 0, temperatures_RAD_C);
}
 Serial.println(temperatures_RAD);




 











}

